#include "timer.h"
#include "led.h"
#include "dac.h"
#include "math.h"




u16 vals;
u16 counter;
u8 mode;
u16 divider;
u16 sin_wave[300]={2000,2041,2083,2125,2167,2209,2250,2292,2333,2374,2415,2456,2497,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1916,1958};
void TIM3_Int_Init(u16 arr,u16 psc)
{
    TIM_TimeBaseInitTypeDef  TIM_TimeBaseStructure;
	NVIC_InitTypeDef NVIC_InitStructure;

	RCC_APB1PeriphClockCmd(RCC_APB1Periph_TIM3, ENABLE); 
	
	
	TIM_TimeBaseStructure.TIM_Period = arr; 
	TIM_TimeBaseStructure.TIM_Prescaler =psc; 
	TIM_TimeBaseStructure.TIM_ClockDivision = TIM_CKD_DIV1; 
	TIM_TimeBaseStructure.TIM_CounterMode = TIM_CounterMode_Up;  
	TIM_TimeBaseInit(TIM3, &TIM_TimeBaseStructure); 
 
	TIM_ITConfig(TIM3,TIM_IT_Update,ENABLE ); 

	
	NVIC_InitStructure.NVIC_IRQChannel = TIM3_IRQn;  
	NVIC_InitStructure.NVIC_IRQChannelPreemptionPriority = 0;  
	NVIC_InitStructure.NVIC_IRQChannelSubPriority = 3;  
	NVIC_InitStructure.NVIC_IRQChannelCmd = ENABLE; 
	NVIC_Init(&NVIC_InitStructure);  
	vals=0;
	counter=0;
	
	mode=0;
	divider=2;

	TIM_Cmd(TIM3, ENABLE);  
}

void TIM3_IRQHandler(void)   
{
	if (TIM_GetITStatus(TIM3, TIM_IT_Update) != RESET)  
		{
		TIM_ClearITPendingBit(TIM3, TIM_IT_Update  );  
		
		if(mode==0)
		{
			vals=counter*4000;
		}
		else if(mode==1)
		{
			vals=((float)counter/divider)*4000;
		}
		else if(mode==2)
		{
			vals=sin_wave[counter];
		}
		DAC_SetChannel1Data(DAC_Align_12b_R, vals);
		
		counter++;
		counter%=divider;
		
		}
}



